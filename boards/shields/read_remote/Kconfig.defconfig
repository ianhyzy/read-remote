## boards/shields/read_remote/Kconfig.defconfig
```kconfig
if SHIELD_READ_REMOTE

config ZMK_KEYBOARD_NAME
    default "Read Remote"

endif
```

## config/west.yml
```yaml
manifest:
  defaults:
    revision: v0.3      # ZMK stable; on main the board id becomes xiao_ble//zmk
  remotes:
    - name: zmkfirmware
      url-base: https://github.com/zmkfirmware
  projects:
    - name: zmk
      remote: zmkfirmware
      import: app/west.yml
  self:
    path: config
```
